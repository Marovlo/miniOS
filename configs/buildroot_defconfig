## configs/buildroot_defconfig
```kconfig
# miniOS buildroot configuration for RVVM
# Target: rv64gc Linux with networking and NVMe storage

# Architecture
BR2_riscv=y
BR2_RISCV_64=y
BR2_riscv_g=y

# Toolchain (musl is smaller than glibc)
BR2_TOOLCHAIN_BUILDROOT_MUSL=y

# Linux Kernel
BR2_LINUX_KERNEL=y
BR2_LINUX_KERNEL_CUSTOM_VERSION=y
BR2_LINUX_KERNEL_CUSTOM_VERSION_VALUE="6.6.70"
BR2_LINUX_KERNEL_USE_DEFCONFIG=y
BR2_LINUX_KERNEL_DEFCONFIG="defconfig"
BR2_LINUX_KERNEL_IMAGE_TARGET_CUSTOM=y
BR2_LINUX_KERNEL_IMAGE_TARGET_NAME="Image"

# Root filesystem - ext4, 256MB
BR2_TARGET_ROOTFS_EXT2=y
BR2_TARGET_ROOTFS_EXT2_4=y
BR2_TARGET_ROOTFS_EXT2_SIZE="256M"

# System configuration
BR2_TARGET_GENERIC_HOSTNAME="minios"
BR2_TARGET_GENERIC_ISSUE="Welcome to miniOS"
BR2_TARGET_GENERIC_ROOT_PASSWD="root"
BR2_TARGET_GENERIC_GETTY_PORT="ttyS0"
BR2_TARGET_GENERIC_GETTY_BAUDRATE_115200=y
BR2_SYSTEM_DHCP="eth0"
BR2_INIT_BUSYBOX=y

# BusyBox
BR2_PACKAGE_BUSYBOX=y
BR2_PACKAGE_BUSYBOX_SHOW_OTHERS=y

# Networking
BR2_PACKAGE_DHCPCD=y
BR2_PACKAGE_DROPBEAR=y
BR2_PACKAGE_WGET=y

# Utilities
BR2_PACKAGE_NANO=y
BR2_PACKAGE_HTOP=y
BR2_PACKAGE_MAKE=y
```
